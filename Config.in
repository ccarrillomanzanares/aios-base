## package/alsa-ucm-conf/Config.in
```kconfig
config BR2_PACKAGE_ALSA_UCM_CONF
	bool "alsa-ucm-conf"
	depends on BR2_PACKAGE_ALSA_LIB
	help
	  Perfiles UCM de ALSA: describen cómo usar altavoces, auriculares y
	  micrófonos de cada tarjeta. Imprescindibles con SOF (micrófonos
	  digitales de los portátiles Intel); PipeWire/WirePlumber los usan.

	  https://github.com/alsa-project/alsa-ucm-conf
```

## package/grim/Config.in
```kconfig
config BR2_PACKAGE_GRIM
	bool "grim"
	depends on BR2_PACKAGE_WAYLAND
	select BR2_PACKAGE_PIXMAN
	select BR2_PACKAGE_LIBPNG
	select BR2_PACKAGE_WAYLAND_PROTOCOLS
	help
	  Capturas de pantalla en Wayland (sway). La usan la tecla Impr
	  Pant, /look y aios-diag.

	  https://sr.ht/~emersion/grim/
```

## package/mako/Config.in
```kconfig
config BR2_PACKAGE_MAKO
	bool "mako"
	depends on BR2_PACKAGE_WAYLAND
	depends on BR2_PACKAGE_SYSTEMD
	select BR2_PACKAGE_CAIRO
	select BR2_PACKAGE_PANGO
	select BR2_PACKAGE_WAYLAND_PROTOCOLS
	help
	  Notificaciones de escritorio para sway (las de las aplicaciones y
	  los avisos de AIOS: batería baja, actualizaciones...).

	  https://github.com/emersion/mako
```

## package/sof-bin/Config.in
```kconfig
config BR2_PACKAGE_SOF_BIN
	bool "sof-bin"
	help
	  Firmware y topologías de Sound Open Firmware (SOF) para el DSP de
	  audio de Intel (Ice Lake y posteriores, y los micrófonos digitales
	  de casi todos los portátiles Intel actuales). Binarios firmados por
	  Intel.

	  https://github.com/thesofproject/sof-bin
```

## package/swayidle/Config.in
```kconfig
config BR2_PACKAGE_SWAYIDLE
	bool "swayidle"
	depends on BR2_PACKAGE_WAYLAND
	depends on BR2_PACKAGE_SYSTEMD
	select BR2_PACKAGE_WAYLAND_PROTOCOLS
	help
	  Acciones por inactividad (bloquear, apagar la pantalla) y antes de
	  suspender (tapa cerrada), vía logind.

	  https://github.com/swaywm/swayidle
```

## package/swaylock/Config.in
```kconfig
config BR2_PACKAGE_SWAYLOCK
	bool "swaylock"
	depends on BR2_PACKAGE_WAYLAND
	depends on BR2_PACKAGE_LINUX_PAM
	select BR2_PACKAGE_CAIRO
	select BR2_PACKAGE_LIBXKBCOMMON
	select BR2_PACKAGE_WAYLAND_PROTOCOLS
	help
	  Bloqueo de pantalla para sway (con PAM: la contraseña del usuario).

	  https://github.com/swaywm/swaylock
```

## package/whisper-cpp/Config.in
```kconfig
config BR2_PACKAGE_WHISPER_CPP
	bool "whisper-cpp"
	depends on BR2_INSTALL_LIBSTDCPP
	depends on BR2_TOOLCHAIN_HAS_THREADS
	help
	  Reconocimiento de voz local (Whisper) en CPU. Va en /opt/whisper
	  con su propio ggml: el de llama.cpp es de otra versión y las
	  bibliotecas libggml*.so chocarían en /usr/lib.

	  https://github.com/ggml-org/whisper.cpp
```

## package/wl-clipboard/Config.in
```kconfig
config BR2_PACKAGE_WL_CLIPBOARD
	bool "wl-clipboard"
	depends on BR2_PACKAGE_WAYLAND
	select BR2_PACKAGE_WAYLAND_PROTOCOLS
	help
	  wl-copy y wl-paste: el portapapeles de Wayland. Lo usa la
	  herramienta 'clipboard' del agente ("resume lo que he copiado").

	  https://github.com/bugaevc/wl-clipboard
```

## package/wl-mirror/Config.in
```kconfig
config BR2_PACKAGE_WL_MIRROR
	bool "wl-mirror"
	depends on BR2_PACKAGE_WAYLAND
	depends on BR2_PACKAGE_MESA3D_OPENGL_EGL
	depends on BR2_PACKAGE_MESA3D_OPENGL_ES
	help
	  Duplicar una pantalla en otra (sway no lo hace por sí mismo).
	  Lo usa 'aios ui display mirror'.

	  https://github.com/Ferdi265/wl-mirror
```

## package/wtype/Config.in
```kconfig
config BR2_PACKAGE_WTYPE
	bool "wtype"
	depends on BR2_PACKAGE_WAYLAND
	select BR2_PACKAGE_LIBXKBCOMMON
	help
	  Escribe texto en la ventana que tenga el foco, como un teclado
	  virtual (protocolo virtual-keyboard de wlroots). Lo usa el
	  dictado de AIOS (aios-voice dictate).

	  https://github.com/atx/wtype
```
